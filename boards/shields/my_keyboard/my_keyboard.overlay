/ {
    chosen {
        zmk,keyboard = &my_keyboard;
    };
};

&my_keyboard {
    compatible = "zmk,keyboard";
    diode-direction = <ROW2COL>;

    matrix-pins {
        row-gpios = <&gpio0 31>, <&gpio0 29>, <&gpio0 2>, <&gpio1 15>, <&gpio1 13>, <&gpio0 10>;
        col-gpios = <&gpio0 17>, <&gpio0 20>, <&gpio0 22>, <&gpio0 24>, <&gpio1 0>, <&gpio0 11>, <&gpio1 6>;
    };
};
